## boards/Kconfig
```kconfig
menu "Board Configuration"
    choice
    prompt "Chip Family Configuration"
    default CHIP_FAMILY_SOPHGO

    config CHIP_FAMILY_QEMU
        bool "Qemu"
        help
            Support for the qemu boards.
    config CHIP_FAMILY_SOPHGO
        bool "Sophgo"
        help
            Support for the sophgo boards.

    endchoice

    if CHIP_FAMILY_SOPHGO
        source "$RV_RTT_ROOT/boards/sophgo/Kconfig"
    endif
    
    if CHIP_FAMILY_QEMU
        source "$RV_RTT_ROOT/boards/qemu/Kconfig"
    endif

endmenu
```

## boards/qemu/Kconfig
```kconfig
choice
    prompt "Board Configuration"
    default BOARD_NAME_RISCV_VIRT64

    config BOARD_NAME_RISCV_VIRT64
        bool "riscv-virt64"
        help
          QEMU Virt64 RISCV board
endchoice

choice 
    prompt "Chip Configuration"
    default CHIP_NAME_RISCV_VIRT64

    config CHIP_NAME_RISCV_VIRT64
        bool "riscv-virt64"

endchoice
```

## boards/sophgo/Kconfig
```kconfig
config SOC_NAME_CV180X
    bool
    default n

config SOC_NAME_SG2002
    bool
    default n

choice
    prompt "Board Configuration"
    default BOARD_NAME_MILKV_DUO256M_SD

    config BOARD_NAME_MILKV_DUO_SD
        select SOC_NAME_CV180X
        bool "milkv-duo-sd"

    config BOARD_NAME_MILKV_DUO_SPINOR
        select SOC_NAME_CV180X
        bool "milkv-duo-spinor"

    config BOARD_NAME_MILKV_DUO256M_SD
        select SOC_NAME_SG2002
        bool "milkv-duo256m-sd"

    config BOARD_NAME_MILKV_DUO256M_SPINOR
        select SOC_NAME_SG2002
        bool "milkv-duo256m-spinor"

    config BOARD_NAME_LICHEERV_NANO_SD
        select SOC_NAME_SG2002
        bool "licheerv-nano-sd"

endchoice

choice 
    prompt "Chip Configuration"
    default CHIP_NAME_RISCV64_C906

    config CHIP_NAME_RISCV64_C906
        bool "riscv64-c906"

    config CHIP_NAME_RISCV64_C906_LITTLE
        bool "riscv64-c906-little"

    config CHIP_NAME_AARCH64_A53
        bool "aarch64-a53"

endchoice

source "$RV_RTT_ROOT/boards/sophgo/$BOARD_NAME/Kconfig"
```
