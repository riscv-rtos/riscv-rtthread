## rt-thread/chip/sophgo/Kconfig
```kconfig
if CHIP_NAME_RISCV64_C906
    source "$RTT_DIR/chip/sophgo/riscv64_c906/Kconfig"
endif

if CHIP_NAME_RISCV64_C906_LITTLE
    source "$RTT_DIR/chip/sophgo/riscv64_c906_little/Kconfig"
endif
```

## rt-thread/chip/sophgo/riscv64_c906/Kconfig
```kconfig
config BSP_USING_CV18XX
    bool
    select ARCH_RISCV64
    select ARCH_RISCV_FPU_D
    select RT_USING_SYSTEM_WORKQUEUE
    select RT_USING_COMPONENTS_INIT
    select RT_USING_USER_MAIN
    select RT_USING_CACHE
    select RT_USING_DEVICE_OPS
    default y

config C906_PLIC_PHY_ADDR
    hex
    default 0x70000000

config IRQ_MAX_NR
    int 
    default 64

config TIMER_CLK_FREQ
    int
    default 25000000

config GPIO_IRQ_BASE
    int
    default 60

config SYS_GPIO_IRQ_BASE
    int
    default 70

config UART_IRQ_BASE
    int
    default 44
                
config I2C_IRQ_BASE
    int
    default 49

config __STACKSIZE__
    int "stack size for interrupt"
    default 4096
```

## rt-thread/chip/sophgo/riscv64_c906_little/Kconfig
```kconfig
config BSP_USING_C906_LITTLE
    bool
    select ARCH_RISCV64
    select ARCH_RISCV_FPU_D
    select RT_USING_COMPONENTS_INIT
    select RT_USING_USER_MAIN
    default y

config PLIC_PHY_ADDR
    hex
    default 0x70000000

config IRQ_MAX_NR
    int 
    default 128

config TIMER_CLK_FREQ
    int
    default 25000000

config GPIO_IRQ_BASE
    int
    default 41

config SYS_GPIO_IRQ_BASE
    int
    default 47

config UART_IRQ_BASE
    int
    default 30

config I2C_IRQ_BASE
    int
    default 32
```
